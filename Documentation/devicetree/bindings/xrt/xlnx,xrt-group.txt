## Documentation/devicetree/bindings/xrt/xlnx,xrt-group.txt
```
* Xilinx XRT group driver for Alveo platforms

Required properties:
- compatible: xlnx,xrt-group
- #address-cells: should be 2.
- #size-cells: should be 2.

Required subnodes:
- addressable_endpoints: Contains hardware endpoints of the Alveo platform partition.

Optional properties:
- ranges: XRT group address translation.
  <endpoint BAR index> <physical address> <size>

Example:

	group@48,0 {
		compatible = "xlnx,xrt-group";
		#address-cells = <2>;
		#size-cells = <2>;
		ranges = <0 0xe0000000 0x2000000
			  2 0xe4200000 0x40000>;
                addressable_endpoints {
                        ep_fpga_configuration_00@0 {
                                reg = <0x1e88000 0x8000>;
                                compatible = "xilinx.com,reg_abs-axi_hwicap-1.0\0axi_hwicap";
                        };
                };
        };
```

## drivers/clk/xilinx/Kconfig
```kconfig
# SPDX-License-Identifier: GPL-2.0

config XILINX_VCU
	tristate "Xilinx VCU logicoreIP Init"
	depends on HAS_IOMEM && COMMON_CLK
	select REGMAP_MMIO
	help
	  Provides the driver to enable and disable the isolation between the
	  processing system and programmable logic part by using the logicoreIP
	  register set. This driver also configures the frequency based on the
	  clock information from the logicoreIP register set.

	  If you say yes here you get support for the logicoreIP.

	  If unsure, say N.

	  To compile this driver as a module, choose M here: the
	  module will be called xlnx_vcu.

config XRT_CLK_WIZ
	tristate "Clock driver for Xilinx Alveo clocking wizard"
	depends on FPGA_XRT_LIB
	select XRT_CLK_FREQ
	select XRT_CLK_UCS
	help
	  Select this option to enable the Alveo clock driver. When FPGA
	  manager programs Alveo FPGA, it needs to set the clock frequency.
	  This driver provides the interfaces to configure the fclock
	  frequency.

config XRT_CLK_FREQ
	tristate "Driver for Xilinx Alveo clock frequency counter"
	depends on FPGA_XRT_LIB
	depends on XRT_CLK_WIZ
	help
	  Select this option to enable the Alveo clock frequency counter
	  driver. The Alveo clock frequency counter indicates if the clock
	  is configured correctly. This driver provides the function to
	  read the frequency counter.

config XRT_CLK_UCS
	tristate "Driver for Xilinx Alveo user clock subsystem controller"
	depends on FPGA_XRT_LIB
	depends on XRT_CLK_WIZ
	help
	  Select this option to enable the Alveo user clock subsystem (UCS)
	  controller driver. After configuring the clock frequency, the UCS
	  controller needs to be enabled. This driver provides the function
	  to enable UCS.
```

## drivers/dma/amdmqdma/Kconfig
```kconfig
# SPDX-License-Identifier: GPL-2.0-only
#
# Copyright (C) 2022, Advanced Micro Devices, Inc.
#
menuconfig AMD_MQDMA
	tristate "AMD Queue-based DMA"
	depends on HAS_IOMEM
	select DMA_ENGINE
	select DMA_VIRTUAL_CHANNELS
	select REGMAP_MMIO
	help
		Enable support for the AMD Queue-based DMA subsystem.The
		primary mechanism to transfer data using the QDMA is for
		the QDMA engine to operate on instructions (descriptors)
		provided by the host operating system. Using the descriptors,
		the QDMA can move data in both the Host to Card (H2C)
		direction, or the Card to Host (C2H) direction.
		The core also provides up to 8 user interrupt wires that
		generate interrupts to the host.
```

## drivers/fpga/xrt/metadata/Kconfig
```kconfig
# SPDX-License-Identifier: GPL-2.0-only
#
# XRT Alveo FPGA device configuration
#

config FPGA_XRT_METADATA
	bool "XRT Alveo Driver Metadata Parser"
	select LIBFDT
	help
	  This option provides helper functions to parse Xilinx Alveo FPGA
	  firmware metadata. The metadata is in device tree format and XRT
	  driver uses it to discover HW subsystems behind PCIe BAR.
```

## drivers/fpga/xrt/selftests/Kconfig
```kconfig
# SPDX-License-Identifier: GPL-2.0-only
#
# Xilinx XRT FPGA device configuration
#

config FPGA_XRT_SELFTESTS
	tristate "Xilinx Alveo Selftest Driver"
	depends on FPGA_XRT_LIB
	select LIBFDT
	help
	  XRT Alveo FPGA selftest driver.
```

## drivers/fpga/xrt/user/Kconfig
```kconfig
# SPDX-License-Identifier: GPL-2.0-only
#
# Xilinx XRT FPGA device configuration
#

config FPGA_XRT_USER
	tristate "Xilinx Alveo User Driver"
	depends on FPGA_XRT_LIB
	select FPGA_XRT_METADATA
	help
	  Select this option to enable XRT PCIe driver for Xilinx Alveo FPGA user
	  function. This driver provides interfaces for userspace application to access
	  Alveo FPGA device.
```
